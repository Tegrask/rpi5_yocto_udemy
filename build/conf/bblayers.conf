## build/conf/bblayers.conf
```bitbake
# POKY_BBLAYERS_CONF_VERSION is increased each time build/conf/bblayers.conf
# changes incompatibly
POKY_BBLAYERS_CONF_VERSION = "2"

BBPATH = "${TOPDIR}"
BBFILES ?= ""

BBLAYERS ?= " \
  ${TOPDIR}/../externals/poky/meta \
  ${TOPDIR}/../externals/poky/meta-poky \
  ${TOPDIR}/../externals/poky/meta-yocto-bsp \
  ${TOPDIR}/../externals/meta-openembedded/meta-gnome \
  ${TOPDIR}/../externals/meta-openembedded/meta-networking \
  ${TOPDIR}/../externals/meta-openembedded/meta-python \
  ${TOPDIR}/../externals/meta-openembedded/meta-multimedia \
  ${TOPDIR}/../externals/meta-openembedded/meta-xfce\
  ${TOPDIR}/../externals/meta-qt5 \
  ${TOPDIR}/../externals/meta-openembedded/meta-oe \
  ${TOPDIR}/../externals/meta-raspberrypi \
  ${TOPDIR}/../sources/meta-moz \
  "
```
